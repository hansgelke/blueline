## code/build/Kconfig/boards/Kconfig
```kconfig
# Load Zephyr board Kconfig descriptions.
osource "/Users/hansgelke/zephyrproject/zephyr/boards/raspberrypi/rpi_pico2/Kconfig"
```

## code/build/Kconfig/boards/Kconfig.rpi_pico2
```kconfig
# Load board Kconfig descriptions.
osource "/Users/hansgelke/zephyrproject/zephyr/boards/raspberrypi/rpi_pico2/Kconfig.rpi_pico2"
```

## code/build/Kconfig/boards/Kconfig.sysbuild
```kconfig
# Load Sysbuild board Kconfig descriptions.
osource "/Users/hansgelke/zephyrproject/zephyr/boards/raspberrypi/rpi_pico2/Kconfig.sysbuild"
```

## code_blueline/build/Kconfig/arch/Kconfig
```kconfig
# Load Zephyr Arch Kconfig descriptions.
osource "/Users/hansgelke/zephyrproject/zephyr/arch/rx/Kconfig"
osource "/Users/hansgelke/zephyrproject/zephyr/arch/x86/Kconfig"
osource "/Users/hansgelke/zephyrproject/zephyr/arch/xtensa/Kconfig"
osource "/Users/hansgelke/zephyrproject/zephyr/arch/sparc/Kconfig"
osource "/Users/hansgelke/zephyrproject/zephyr/arch/riscv/Kconfig"
osource "/Users/hansgelke/zephyrproject/zephyr/arch/posix/Kconfig"
osource "/Users/hansgelke/zephyrproject/zephyr/arch/mips/Kconfig"
osource "/Users/hansgelke/zephyrproject/zephyr/arch/arm64/Kconfig"
osource "/Users/hansgelke/zephyrproject/zephyr/arch/arm/Kconfig"
osource "/Users/hansgelke/zephyrproject/zephyr/arch/arc/Kconfig"
```
